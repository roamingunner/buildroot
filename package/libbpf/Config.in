## package/libbpf/Config.in
```kconfig
config BR2_PACKAGE_LIBBPF
	bool "libbpf"
	select BR2_PACKAGE_ELFUTILS
	select BR2_PACKAGE_ZLIB
	help
	  libbpf

choice
	prompt "choice libbpf version"
	help
	  choice libbpf version

config BR2_PACKAGE_LIBBPF_STANDALONE_VESION
	bool "build libbpf standalone version"

config BR2_PACKAGE_LIBBPF_LINUX_KERNEL_VERSION
	bool "build libbpf in linux kernel builtin version"
	depends on BR2_LINUX_KERNEL
	select BR2_PACKAGE_BINUTILS
endchoice
```
