## package/libbpf-bootstrap/Config.in
```kconfig
config BR2_PACKAGE_LIBBPF_BOOTSTRAP
	bool "libbpf-bootstrap"
	depends on BR2_PACKAGE_LIBBPF
	depends on BR2_PACKAGE_ELFUTILS
	depends on BR2_PACKAGE_ZLIB
	help
	  libbpf-bootstrap
```

## package/libbpf-tools/Config.in
```kconfig
config BR2_PACKAGE_LIBBPF_TOOLS
	bool "libbpf-tools"
	depends on BR2_PACKAGE_LIBBPF
	depends on BR2_PACKAGE_ELFUTILS
	depends on BR2_PACKAGE_ZLIB
	help
	  libbpf-tools in bcc project
```
